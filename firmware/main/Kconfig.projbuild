## firmware/main/Kconfig.projbuild
```kconfig
menu "DetectaChem firmware"

    choice DC_SENSOR
        prompt "Optical sensor"
        default DC_SENSOR_MOCK

        config DC_SENSOR_MOCK
            bool "Mock sensor (replays a fixed table)"

        config DC_SENSOR_TCS3448
            bool "TCS3448 (ams OSRAM, I2C)"
    endchoice

    config DC_LFA_AS7343
        bool "AS7343 on second/control LFA zone (TCS3448 on first/test zone)"
        depends on DC_SENSOR_TCS3448
        default n

    config DC_SENSOR_LEDS
        bool "Also light the sensor boards' onboard white LEDs during a measurement"
        depends on DC_SENSOR_TCS3448
        default n
        help
            Turns on the white LED on the TCS3448 breakout (and the AS7343
            breakout in the dual build) together with the GPIO LED, for as
            long as the GPIO LED is on.

    config DC_SENSOR_LED_MA
        int "Onboard white LED current at 100% intensity (mA)"
        depends on DC_SENSOR_LEDS
        range 4 258
        default 20
        help
            Chip limit is 258 mA; 20 mA matches Adafruit's example. Raise it
            only after checking the LED's rating on the breakout schematic.

    choice DC_SINK
        prompt "Result output"
        default DC_SINK_LOG

        config DC_SINK_LOG
            bool "Serial log"

        config DC_SINK_BLE
            bool "BLE (MobileDetect, placeholder format)"
    endchoice

    config DC_BLE_DEVICE_NAME
        string "BLE device name"
        default "DetectaChem-T2"

endmenu
```

## firmware/sdkconfig.defaults
```kconfig
CONFIG_BT_ENABLED=y
CONFIG_BT_NIMBLE_ENABLED=y
CONFIG_DC_SENSOR_MOCK=y
CONFIG_DC_SINK_LOG=y
```
